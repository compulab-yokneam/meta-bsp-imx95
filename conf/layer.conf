## conf/layer.conf
```bitbake
# We have a conf and classes directory, add to BBPATH
BBPATH .= ":${LAYERDIR}"

# We have recipes-* directories, add to BBFILES
BBFILES += "${LAYERDIR}/recipes-*/*/*.bb \
            ${LAYERDIR}/recipes-*/*/*.bbappend"

BBFILE_COLLECTIONS += "meta-bsp-imx95"
BBFILE_PATTERN_meta-bsp-imx95 = "^${LAYERDIR}/"
BBFILE_PRIORITY_meta-bsp-imx95 = "6"

LAYERDEPENDS_meta-bsp-imx95 = "core"
LAYERSERIES_COMPAT_meta-bsp-imx95 = "walnascar"

CORE_IMAGE_EXTRA_INSTALL += " kernel-modules "
CORE_IMAGE_EXTRA_INSTALL += " firmware-onsemi "

BBMASK += "bt-start_1.0.bb"
BBMASK += "meta-compulab/recipes-graphics/wayland"
BBMASK += "u-boot-fw-utils_%.bbappend"
BBMASK += "linux-firmware_git.bbappend"
BBMASK += "xfce4-power-manager_%.bbappend nxp-wlan-sdk_%.bbappend nxp-wlan-sdk_git.bbappend"

HOSTTOOLS += " rsync "

ERROR_QA:remove = "patch-status"
```

## conf/machine/compulab-imx95.inc
```bitbake
MACHINEOVERRIDES =. "mx95:compulab-mx95:"

require conf/machine/include/imx-base.inc
require conf/machine/include/arm/armv8-2a/tune-cortexa55.inc

MACHINE_FEATURES += "pci wifi bluetooth optee"
MACHINE_FEATURES:append:use-nxp-bsp = " nxpwifi-all-pcie nxpwifi-all-sdio jailhouse dpdk xen"

IMX_DEFAULT_BOOTLOADER:use-nxp-bsp = "u-boot-compulab"
IMX_DEFAULT_BOOTLOADER:use-mainline-bsp = "u-boot-compulab"

LOADADDR = ""
UBOOT_SUFFIX = "bin"
UBOOT_MAKE_TARGET = ""

SPL_BINARY = "spl/u-boot-spl.bin"

IMXBOOT_TARGETS_BASENAME = "flash"

ATF_PLATFORM = "imx95"
OEI_CONFIGS = "ddr tcm"
OEI_CORE   = "m33"
OEI_SOC    = "mx95"
OEI_BOARD  = "mx95lp5"
DDR_TYPE   = "lpddr5"

DDR_FIRMWARE_NAME = " \
    lpddr5_dmem_v202409.bin \
    lpddr5_dmem_qb_v202409.bin \
    lpddr5_imem_v202409.bin \
    lpddr5_imem_qb_v202409.bin \
"

M4_DEFAULT_IMAGE_MX95 = "imx95-19x19-evk_m7_TCM_power_mode_switch.bin"

SYSTEM_MANAGER_CONFIG = "${@bb.utils.contains('IMXBOOT_VARIANT','rpmsg','mx95cplrpmsg','mx95cpl', d)}"

IMXBOOT_TARGETS = "${IMXBOOT_TARGETS_BASENAME}_all ${IMXBOOT_TARGETS_BASENAME}_lpboot_sm_a55"

IMX_BOOT_SOC_TARGET = "iMX95"
IMX_BOOT_SEEK = "32"

SERIAL_CONSOLES = "115200;ttyLP0"

PREFERRED_PROVIDER_virtual/kernel:compulab-mx95 = "linux-compulab"
PREFERRED_PROVIDER_virtual/bootloader:compulab-mx95 = "u-boot-compulab"

IMAGE_INSTALL:append = " \
	kernel-image \
	kernel-modules \
	kernel-devicetree \
"

PREFERRED_RROVIDER_u-boot-fw-utils = "libubootenv-bin"

DISTRO_FEATURES:remove = "sysvinit"

IMX_DEFAULT_BSP = "nxp"

KERNEL_DEVICETREE:append = " \
    compulab/imx95-lvds.dtbo \
    compulab/imx95-wm8962.dtbo \
    compulab/imx95-rpmsg.dtbo \
    compulab/imx95-csi1-ap1302.dtbo \
    compulab/imx95-csi2-ap1302.dtbo \
"
```

## conf/machine/compulab-imx952.inc
```bitbake
MACHINEOVERRIDES =. "mx952:compulab-mx952:"

require conf/machine/include/imx-base.inc
require conf/machine/include/arm/armv8-2a/tune-cortexa55.inc

MACHINE_FEATURES += "pci wifi bluetooth optee"
MACHINE_FEATURES:append:use-nxp-bsp = " crrm jailhouse nxpwifi-all-sdio nxpaw693-pcie xen"

IMX_DEFAULT_BOOTLOADER:use-nxp-bsp = "u-boot-compulab"
IMX_DEFAULT_BOOTLOADER:use-mainline-bsp = "u-boot-compulab"

LOADADDR = ""
UBOOT_SUFFIX = "bin"
UBOOT_MAKE_TARGET = ""

SPL_BINARY = "spl/u-boot-spl.bin"

UBOOT_CONFIG ??= "${@bb.utils.contains('COMBINED_FEATURES', 'crrm', 'crrm', 'sd', d)}"
UBOOT_CONFIG[sd] = "${UBOOT_CONFIG_BASENAME}_defconfig"
UBOOT_CONFIG[sd-ecc] = "${UBOOT_CONFIG_BASENAME}_defconfig"
UBOOT_CONFIG[crrm] = "${UBOOT_CONFIG_BASENAME}_xspi_crrm_defconfig"
UBOOT_CONFIG[xspi] = "${UBOOT_CONFIG_BASENAME}_xspi_defconfig"

IMXBOOT_TARGETS_BASENAME = "flash"

ATF_PLATFORM = "imx952"
OEI_CORE   = "m33"
OEI_SOC    = "mx952"
OEI_BOARD  = "mx952lp5-19"
DDR_TYPE   = "lpddr5"
DDR_FIRMWARE_NAME = " \
    lpddr5_dmem_v202409.bin \
    lpddr5_dmem_qb_v202409.bin \
    lpddr5_imem_v202409.bin \
    lpddr5_imem_qb_v202409.bin \
"

IMXBOOT_VARIANTS = "alt jailhouse netc rpmsg"

# Multiple system manager configs by IMXBOOT_VARIANT
SYSTEM_MANAGER_CONFIG = "${@bb.utils.contains('IMXBOOT_VARIANT','rpmsg','mx952cplrpmsg','mx952cpl', d)}"

# imx-boot (flash.bin) targets based on UBOOT_CONFIG and IMXBOOT_VARIANT
IMXBOOT_TARGETS_SD = " \
    ${@bb.utils.contains('IMXBOOT_VARIANT', 'alt',       '${IMXBOOT_TARGETS_BASENAME}_all', \
       bb.utils.contains('IMXBOOT_VARIANT', 'jailhouse', '${IMXBOOT_TARGETS_BASENAME}_jailhouse', \
       bb.utils.contains('IMXBOOT_VARIANT', 'netc',      '${IMXBOOT_TARGETS_BASENAME}_all', \
       bb.utils.contains('IMXBOOT_VARIANT', 'rpmsg',     '${IMXBOOT_TARGETS_BASENAME}_lpboot_sm_a55', \
                                                         '${IMXBOOT_TARGETS_BASENAME}_all ${IMXBOOT_TARGETS_BASENAME}_a55', d), d), d), d)} \
"
IMXBOOT_TARGETS = " \
    ${@bb.utils.contains('UBOOT_CONFIG', 'crrm',   '${IMXBOOT_TARGETS_BASENAME}_a55_xspi_crrm', \
       bb.utils.contains('UBOOT_CONFIG', 'sd-ecc', '${IMXBOOT_TARGETS_BASENAME}_all', \
       bb.utils.contains('UBOOT_CONFIG', 'xspi',   '${IMXBOOT_TARGETS_BASENAME}_a55_xspi', \
                                                   '${IMXBOOT_TARGETS_SD}', d), d), d)} \
"

M4_DEFAULT_IMAGE_MX952 = "${@bb.utils.contains('IMXBOOT_VARIANT', 'netc', 'imx952evk_m7_TCM_netc_share.bin', \
                                                                          'imx952evk_m7_TCM_power_mode_switch.bin', d)}"

IMX_BOOT_SOC_TARGET = "iMX952"
IMX_BOOT_SEEK = "32"

# We have to disable SERIAL_CONSOLE due to auto-serial-console
SERIAL_CONSOLES = "115200;ttyLP0"

IMX_DEFAULT_BSP = "nxp"

KERNEL_DEVICETREE:append = " \
    compulab/imx952-csi1-ap1302.dtbo \
    compulab/imx952-csi1-imx219.dtbo \
    compulab/imx952-csi1-imx477.dtbo \
    compulab/imx952-csi2-ap1302.dtbo \
    compulab/imx952-lvds.dtbo \
    compulab/imx952-rpmsg.dtbo \
    compulab/imx952-spidev.dtbo \
    compulab/imx952-wm8962.dtbo \
"

IMAGE_BOOT_FILES:append:imx-nxp-bsp = " \
    mcore-demos/imx952evk_m7_TCM_hello_world.bin \
    mcore-demos/imx952evk_m7_TCM_netc_share.bin \
    mcore-demos/imx952evk_m7_TCM_power_mode_switch.bin \
    mcore-demos/imx952evk_m7_TCM_rpmsg_lite_pingpong_rtos_linux_remote.bin \
    mcore-demos/imx952evk_m7_TCM_rpmsg_lite_str_echo_rtos.bin \
    mcore-demos/imx952evk_m7_TCM_sai_low_power_audio.bin \
    ${@bb.utils.contains('COMBINED_FEATURES', 'xen', 'xen', '', d)} \
"

DRAM_CONF ?= "D8"

require include/compulab-default.inc
```

## conf/machine/include/compulab-default.inc
```bitbake
#
# CompuLab default values
#

PREFERRED_PROVIDER_virtual/kernel:compulab-mx95 = "linux-compulab"
PREFERRED_PROVIDER_virtual/bootloader:compulab-mx95 = "u-boot-compulab"

PREFERRED_PROVIDER_virtual/kernel:compulab-mx952 = "linux-compulab"
PREFERRED_PROVIDER_virtual/bootloader:compulab-mx952 = "u-boot-compulab"

IMAGE_INSTALL:append = " \
	kernel-image \
	kernel-modules \
	kernel-devicetree \
"

PREFERRED_RROVIDER_u-boot-fw-utils = "libubootenv-bin"

DISTRO_FEATURES:remove = "sysvinit"
```

## conf/machine/mcm-imx95-sbc.conf
```bitbake
#@TYPE: Machine
#@NAME: CompuLab mcm-imx95 Evaluation Kit
#@SOC: i.MX95
#@DESCRIPTION: Machine configuration for CompuLab mcm-imx95 EVK
#@MAINTAINER: compulab@compulab.co.il

require compulab-imx95.inc

KERNEL_DEVICETREE:append = " \
    compulab/mcm-imx95-sbc.dtb \
    compulab/mcm-imx95-rpmsg.dtb \
    compulab/mcm-imx95-evk-csi1-ap1302.dtb \
    compulab/mcm-imx95-evk-csi2-ap1302.dtb \
"

UBOOT_DTB_NAME = "ucm-imx95.dtb"

UBOOT_CONFIG ??= "sd"
UBOOT_CONFIG[sd] = "ucm-imx95_defconfig,sdcard"

KERNEL_MODULE_AUTOLOAD:append = " mlan moal btnxpuart "

CL_RELEASE = "2.0"
```

## conf/machine/ucm-imx95.conf
```bitbake
#@TYPE: Machine
#@NAME: CompuLab ucm-imx95 Evaluation Kit
#@SOC: i.MX95
#@DESCRIPTION: Machine configuration for CompuLab ucm-imx95 EVK
#@MAINTAINER: compulab@compulab.co.il

require compulab-imx95.inc

KERNEL_DEVICETREE:append = " \
    compulab/ucm-imx95-som.dtb \
    compulab/ucm-imx95.dtb \
    compulab/ucm-imx95-rpmsg.dtb \
    compulab/ucm-imx95-evk-csi1-ap1302.dtb \
    compulab/ucm-imx95-evk-csi2-ap1302.dtb \
"

UBOOT_DTB_NAME = "ucm-imx95.dtb"

UBOOT_CONFIG ??= "sd"
UBOOT_CONFIG[sd] = "ucm-imx95_defconfig,sdcard"

KERNEL_MODULE_AUTOLOAD:append = " mlan moal btnxpuart "

CL_RELEASE = "2.1"
```

## conf/machine/ucm-imx952.conf
```bitbake
#@TYPE: Machine
#@NAME: CompuLab ucm-imx952 Evaluation Kit
#@SOC: i.MX952
#@DESCRIPTION: Machine configuration for CompuLab ucm-imx952 EVK
#@MAINTAINER: compulab@compulab.co.il

require compulab-imx952.inc

KERNEL_DEVICETREE:append = " \
    compulab/ucm-imx952-som.dtb \
    compulab/ucm-imx952.dtb \
    compulab/ucm-imx952-evk.dtb \
    compulab/ucm-imx952-evk-csi1-ap1302.dtb \
    compulab/ucm-imx952-evk-csi2-ap1302.dtb \
    compulab/ucm-imx952-evk-csi1-imx219.dtb \
    compulab/ucm-imx952-evk-csi1-imx477.dtb \
"

UBOOT_DTB_NAME = "ucm-imx952.dtb"

UBOOT_CONFIG_BASENAME = "ucm-imx952"

UBOOT_CONFIG ??= "sd"
UBOOT_CONFIG[sd] = "${UBOOT_CONFIG_BASENAME}_defconfig"

KERNEL_MODULE_AUTOLOAD:append = " mlan moal btnxpuart "

CL_RELEASE = "1.0"
```
