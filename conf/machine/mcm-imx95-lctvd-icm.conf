## conf/machine/mcm-imx95-lctvd-icm.conf
```bitbake
#@TYPE: Machine
#@NAME: CompuLab MCM-iMX95 on LCTVD-ICM
#@SOC: i.MX95
#@DESCRIPTION: Machine configuration for the LCTVD-ICM carrier
#@MAINTAINER: compulab@compulab.co.il

require compulab-imx95.inc

KERNEL_DEVICETREE:append = " compulab/sbc-mcm-imx95-lctvd-icm.dtb"
KERNEL_DEVICETREE:remove = " \
    compulab/imx95-lvds.dtbo \
    compulab/imx95-wm8962.dtbo \
    compulab/imx95-rpmsg.dtbo \
    compulab/imx95-csi1-ap1302.dtbo \
    compulab/imx95-csi2-ap1302.dtbo \
    compulab/imx95-csi1-imx219.dtbo \
    compulab/imx95-csi1-imx477.dtbo \
"

UBOOT_DTB_NAME = "mcm-imx95-lctvd-icm.dtb"
UBOOT_CONFIG ??= "sd"
UBOOT_CONFIG[sd] = "mcm-imx95-lctvd-icm_defconfig"
UBOOT_CONFIG_IMAGE_FSTYPES[sd] = "sdcard"

DRAM_CONF = "D8"
MACHINE_FEATURES:remove = " \
    wifi bluetooth nxpwifi-all-pcie nxpwifi-all-sdio \
    alsa touchscreen screen usbhost usbgadget \
"

IMAGE_INSTALL:append = " \
	iperf3 \
	nfs-utils \
"

CL_RELEASE = "0.1"
```
